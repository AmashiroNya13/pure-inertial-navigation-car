#include "sine_control.h"
#include "bldc_config.h"
#include "zf_common_typedef.h"

#pragma warning disable = 183

int16 motor_a_position = 0;
int16 motor_b_position = 0;
int16 motor_c_position = 0;

// 峰值1024
// 一共360个点
const uint16 sine_pwm_arr[] = 
{  
	514,523,532,541,549,558,567,576,585,594,603,611,620,629,638,646,
	655,663,672,680,689,697,705,714,722,730,738,746,754,762,769,777,
	785,792,800,807,814,821,828,835,842,849,856,862,869,875,881,887,
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	442,451,460,469,478,487,496,505
};

//-------------------------------------------------------------------------------------------------------------------
//  @brief      正弦启动初始化
//  @param      void
//  @return     void
//  @since      v1.0
//  Sample usage:
//-------------------------------------------------------------------------------------------------------------------
void sine_init(void)
{
	// 设置位置
	motor_a_position = 0;
	motor_b_position = motor_a_position + 119;
	motor_c_position = motor_a_position + 239;
	
	// 开启PWM输出
	PWMA_CCER1 = 0xFF;		
	PWMA_CCER2 = 0x0F;		
	
	// 使能PWM所有通道
	PWMA_ENO = 0x3F;
}
	


//-------------------------------------------------------------------------------------------------------------------
//  @brief      正弦强拉
//  @param      void
//  @return     void
//  @since      v1.0
//  Sample usage:
//-------------------------------------------------------------------------------------------------------------------
void sine_start(uint16 duty)
{
	uint16 temp = 0;
	
	motor_a_position --;
	if (motor_a_position < 0)
	{
		motor_a_position = 359 ;
	}
	
	motor_b_position --;
	if (motor_b_position < 0)
	{
		motor_b_position = 359;
	}
	
	motor_c_position --;
	if (motor_c_position < 0)
	{
		motor_c_position = 359 ;
	}
	
//	temp = ((uint32)sine_pwm_arr[motor_a_position]  * duty) / 1024;		// 1024为sine_pwm的峰值
	temp = ((uint32)sine_pwm_arr[motor_a_position] * duty) >> 10;
	
	PWMA_CCR1H = (temp >> 8) & 0xFF;
    PWMA_CCR1L = temp & 0xFF;
    
	temp = ((uint32)sine_pwm_arr[motor_b_position] * duty) >> 10;
    PWMA_CCR2H = (temp >> 8) & 0xFF;
    PWMA_CCR2L = temp & 0xFF;
    
	temp = ((uint32)sine_pwm_arr[motor_c_position] * duty) >> 10;
    PWMA_CCR3H = (temp >> 8) & 0xFF;
    PWMA_CCR3L = temp & 0xFF;
	
}
